## Kconfig
```kconfig
config ZMK_INPUT_PROCESSOR_DRAG_SCROLL
    bool "Drag distance gated temporary layer input processor"
    depends on ZMK_POINTING
    depends on !ZMK_SPLIT || ZMK_SPLIT_ROLE_CENTRAL
    default y
```

## config/west.yml
```yaml
manifest:
  remotes:
    - name: zmkfirmware
      url-base: https://github.com/zmkfirmware
    - name: caksoylar
      url-base: https://github.com/caksoylar
    - name: badjeff
      url-base: https://github.com/badjeff
    - name: amgskobo
      url-base: https://github.com/amgskobo
  projects:
    - name: zmk
      remote: zmkfirmware
      revision: main
      import: app/west.yml
    - name: zmk-rgbled-widget
      remote: caksoylar
      revision: main
    - name: zmk-pmw3610-driver
      remote: badjeff
      revision: zmk-0.4
    - name: zmk-input-inertia
      remote: amgskobo
      revision: main  
  self:
    path: config
    
```

## dts/bindings/input_processors/zmk,behavior-drag-scroll.yaml
```yaml
description: Temporary layer input processor gated by relative drag distance

compatible: "zmk,behavior-drag-scroll"

include: ip_zero_param.yaml

properties:
  min-drag-distance:
    type: int
    default: 0
    description: Accumulated relative X/Y movement required before activating the layer.
```
